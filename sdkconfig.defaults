## sdkconfig.defaults
```kconfig
# Rust often needs a bit of an extra main task stack size compared to C (the default is 3K)
CONFIG_ESP_MAIN_TASK_STACK_SIZE=22528
CONFIG_ESP_MAIN_TASK_AFFINITY_NO_AFFINITY=n
# Use this to set FreeRTOS kernel tick frequency to 1000 Hz (100 Hz by default).
# This allows to use 1 ms granuality for thread sleeps (10 ms by default).
CONFIG_FREERTOS_HZ=1000

CONFIG_ESP_SYSTEM_EVENT_TASK_STACK_SIZE=4096
CONFIG_PTHREAD_TASK_STACK_SIZE_DEFAULT=8192
CONFIG_PTHREAD_TASK_PRIO_DEFAULT=23

CONFIG_ESP32_DEFAULT_CPU_FREQ_240=y

# CONFIG_ESP32_SPIRAM_SUPPORT=y
# CONFIG_SPIRAM_SUPPORT=y
# CONFIG_ESP32_SPIRAM_SUPPORT=y
# CONFIG_ESP32S2_SPIRAM_SUPPORT=n
# CONFIG_ESP32S3_SPIRAM_SUPPORT=y
# CONFIG_SPIRAM_SPEED_80M=n
# CONFIG_SPIRAM_IGNORE_NOTFOUND=y
# CONFIG_SPIRAM_USE_MALLOC=y
# CONFIG_SPIRAM_MALLOC_ALWAYSINTERNAL=10
# CONFIG_SPIRAM_ALLOW_BSS_SEG_EXTERNAL_MEMORY=y

CONFIG_ESP_INT_WDT=y
CONFIG_ESP_TASK_WDT=y
CONFIG_VFS_SUPPORT_SELECT=y
CONFIG_ESP32_WIFI_TASK_PINNED_TO_CORE_1=y

CONFIG_ESP_TASK_WDT_EN=y
CONFIG_ESP_TASK_WDT_TIMEOUT_S=10
CONFIG_ESP_TASK_WDT_CHECK_IDLE_TASK_CPU0=y
CONFIG_ESP_TASK_WDT_CHECK_IDLE_TASK_CPU1=y
CONFIG_ESP_TASK_WDT_PANIC=y
CONFIG_ESP_SYSTEM_PANIC_PRINT_HALT=y
```
